## drivers/net/ethernet/txvh/Kconfig
```kconfig
#
# Txvh device configuration
#
config TXVH_SECGMAC 
	tristate "Txvh security gmac gigabit ethernet support"
	default m
	depends on PCI
	select FW_LOADER
	select CRC32
	select MII
	---help---
	  Say Y here if you have a Txvh security gmac PCIe Gigabit Ethernet adapter.

	  To compile this driver as a module, choose M here: the module
	  will be called Txvh_secgmac.  This is recommended.
```
